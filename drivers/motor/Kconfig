## drivers/motor/Kconfig
```kconfig
# Copyright (c) 2026 Carl Zeiss Meditec AG
# SPDX-License-Identifier: Apache-2.0

menuconfig MOTOR
	bool "Motor drivers"
	default y
	depends on DT_HAS_ZEPHYR_DC_MOTOR_ENABLED
	select PWM
	help
	  Enable config options for motor drivers.

if MOTOR

module = MOTOR
module-str = motor_driver
source "subsys/logging/Kconfig.template.log_config"

config MOTOR_INIT_PRIORITY
	int "Init priority"
	default KERNEL_INIT_PRIORITY_DEVICE
	help
	  Motor driver initialization priority.

config MOTOR_SHELL
	bool "Motor shell"
	select SHELL
	select CBPRINTF_FP_SUPPORT
	help
	  Activate shell module to access configured motors.

endif # MOTOR
```

## drivers/peripheral_interconnect/Kconfig
```kconfig
# PECI configuration options

# Copyright (c) 2020 Intel Corporation
# SPDX-License-Identifier: Apache-2.0

menuconfig PERIPHERAL_INTERCONNECT
	bool "Peripheral interconnect drivers"
	help
	  Include peripheral interconnect drivers in system config.

if PERIPHERAL_INTERCONNECT

# zephyr-keep-sorted-start
# zephyr-keep-sorted-stop

module = PERIPHERAL_INTERCONNECT
module-str = peripheral_interconnect
source "subsys/logging/Kconfig.template.log_config"

endif # PERIPHERAL_INTERCONNECT
```

## drivers/sensor/osram/tsl2522/Kconfig
```kconfig
# Copyright (c) 2026 Carl Zeiss Meditec AG
# SPDX-License-Identifier: Apache-2.0

config TSL2522
	bool "ams OSRAM TSL2522 ambient light sensing and light flicker detection sensor"
	default y
	depends on DT_HAS_AMS_TSL2522_ENABLED
	select I2C
	select FPU if CPU_HAS_FPU
	help
	  Enable driver for ams OSRAM TSL2522  ambient light sensing and light flicker detection sensor.
```

## dts/bindings/motor/zephyr,dc-motor.yaml
```yaml
# Copyright (c) 2026 Carl Zeiss Meditec AG
# SPDX-License-Identifier: Apache-2.0

description: |
  DC Motor.

compatible: "zephyr,dc_motor"

include: base.yaml

properties:
  pwms:
    type: phandle-array
    required: true
    description: PWM channels used to drive the motor

  pwm-names:
    type: string-array
    required: true
    description: Names of the PWM channels

  enable-gpios:
    type: phandle-array
    required: true
    description: GPIO for enable/disable
```

## dts/bindings/peripheral_interconnect/nordic,nrf-pinctrl.yaml
```yaml
# Copyright (c) 2026 The Zephyr Project Contributors
# SPDX-License-Identifier: Apache-2.0

title: Nordic nRF DPPI

description: |

compatible: "nordic,nrf-dppi"

include: peripheral-interconnect-device.yaml
```

## dts/bindings/positioning/zephyr,positioning.yaml
```yaml
# Copyright (c) 2026 Carl Zeiss Meditec AG
# SPDX-License-Identifier: Apache-2.0

description: |
  Positioning subsystem to be used by an application.

compatible: "zephyr,positioning"

properties:
  motor-controller:
    type: phandle
    required: true
    description: |
      Node of a motor controller to use

  position-sensor:
    type: phandle
    required: true
    description: |
      Node of a position sensor to use
```

## dts/bindings/regulator/ti,tps62873.yaml
```yaml
# Copyright (c) 2026 Carl Zeiss Meditec AG
# SPDX-License-Identifier: Apache-2.0

description: TPS62873 regulator

compatible: "ti,tps62873"

include:
  - name: i2c-device.yaml
  - name: regulator.yaml
    property-allowlist:
      - regulator-init-microvolt
      - regulator-min-microvolt
      - regulator-max-microvolt
      - regulator-active-discharge

properties:
  input-voltage-microvolt:
    type: int
    min: 2700
    max: 6000
    required: true
    description: |
      Provide the input voltage to the device in order to calculate the
      maximum output voltage. For proper operation, the input voltage
      needs to be at least 1.4V above the selected output voltage

  ssc:
    type: boolean
    description: |
      Enable the spread spectrum clocking function that can reduce
      electromagnetic interference
```

## dts/bindings/sensor/ams,tsl2522.yaml
```yaml
# Copyright (c) 2026 Carl Zeiss Meditec AG
# SPDX-License-Identifier: Apache-2.0

description: |
    ams OSRAM TSL2522 ambient light sensing and light flicker detection sensor. See datasheet at
    https://look.ams-osram.com/m/297a255d37b15c/original/TSL2522-Highly-sensitive-ambient-light-sensor-with-light-flicker-detection.pdf

compatible: "ams,tsl2522"

include: [sensor-device.yaml, i2c-device.yaml]

properties:
  time-per-sample-us:
    type: int
    default: 1000
    min: 100
    max: 1000
    description: |
      Time for each sample

  number-of-samples:
    type: int
    default: 64
    min: 1
    max: 128
    description: |
      Number of samples taken in one conversion

  modulator-gain:
    type: int
    default: 5
    min: 0
    max: 13
    description: |
      Gain used in both modulators

  glass-attenuation:
    type: int
    default: 100000
    description: |
      Visible light attenuation.
      Integer value for a representation with 5 decimal points.
      This default value (1.00000) is chosen for free open space (no glass).
      Example: 1.2 would be 120000

  glass-ir-attenuation:
    type: int
    default: 100000
    description: |
      Infa-red light attenuation.
      Integer value for a representation with 5 decimal points.
      This default value (1.00000) is chosen for free open space (no glass).
      Example: 1.2 would be 120000
```

## dts/bindings/sensor/osram,tsl2522.yaml
```yaml
# Copyright (c) 2026 Carl Zeiss Meditec AG
# SPDX-License-Identifier: Apache-2.0

description: |
    OSRAM TSL2522 ambient light sensing and light flicker detection sensor.

compatible: "osram,tsl2522"

include: [sensor-device.yaml, i2c-device.yaml]
```

## subsys/positioning/Kconfig
```kconfig
# Copyright (c) 2026 Carl Zeiss Meditec AG
# SPDX-License-Identifier: Apache-2.0

config POSITIONING
	bool "Positioning Subsystem"
	default y
	depends on DT_HAS_ZEPHYR_POSITIONING_ENABLED
	select SENSOR
	help
	  Enable Positioning Subsystem.

if POSITIONING

module = POSITIONING
module-str = positioning
source "subsys/logging/Kconfig.template.log_config"

config POSITIONING_INIT_PRIORITY
	int "Positioning init priority"
	default 90
	help
	  Positioning initialization priority.

config POSITIONING_RUNTIME_THREAD_STACK_SIZE
	int "stack size for positioning subsystem runtime thread"
	depends on POSITIONING
	default 4096
	help
	  This is the stack size for positioning subsystem runtime thread
	  Typical values are 4096

config POSITIONING_RUNTIME_THREAD_PRIORITY
	int "priority for positioning subsystem runtime thread"
	depends on POSITIONING
	default 7
	help
	  This is the thread priority for positioning subsystem runtime thread
	  Typical values are 9

endif # POSITIONING
```
