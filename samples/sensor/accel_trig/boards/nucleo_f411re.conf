## samples/sensor/accel_trig/boards/nucleo_f411re.conf
```kconfig
CONFIG_I2C=y
CONFIG_LOG=y
CONFIG_SENSOR_LOG_LEVEL_DBG=y
CONFIG_ADXL345_TRIGGER_GLOBAL_THREAD=y

CONFIG_NO_OPTIMIZATIONS=y
CONFIG_DEBUG_THREAD_INFO=y

CONFIG_MAIN_STACK_SIZE=4096
CONFIG_SYSTEM_WORKQUEUE_STACK_SIZE=2048
```
